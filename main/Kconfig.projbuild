## main/Kconfig.projbuild
```kconfig
menu "Soil Moisture Monitor Configuration"

	config ESP_WIFI_SSID
		string "WiFi AP SSID"
		default "SOIL_MONITOR_AP"
		help
			SSID for the configuration access point.

	config ESP_WIFI_PASSWORD
		string "WiFi AP Password"
		default "soilmonitor2024"
		help
			Password for the configuration access point.

	config ESP_WIFI_CHANNEL
		int "WiFi Channel"
		range 1 13
		default 1
		help
			WiFi channel for the ESP soft-AP.

	config ESP_MAX_STA_CONN
		int "Maximum STA connections"
		default 4
		help
			Maximum number of stations able to connect to the AP.

endmenu
```
